## Kconfig
```kconfig
# Sensor data simulator
#
# Copyright (c) 2019 Nordic Semiconductor
#
# SPDX-License-Identifier: LicenseRef-Nordic-5-Clause
#

menuconfig PMW3610
  bool "PMW3610 mouse optical sensor"
  select SPI
  depends on INPUT
  depends on DT_HAS_CORMORAN_PMW3610_ENABLED
  help
      Enable PMW3610 mouse optical sensor.

if PMW3610

config INPUT_PMW3610_INIT_PRIORITY
    int "PMW3610 initialization priority"
    default INPUT_INIT_PRIORITY

config PMW3610_SWAP_XY
  bool "Swap the X/Y axis of PMW3610 sensor"

config PMW3610_INVERT_X
  bool "Invert the X axis of PMW3610 sensor"

config PMW3610_INVERT_Y
  bool "Invert the Y axis of PMW3610 sensor"

config PMW3610_INIT_POWER_UP_EXTRA_DELAY_MS
  int "Extra power up init delay (ms)"
  default 0
  help
    Default minimum init power up delay is 10ms.
    Use this config to postpone init power up sequence if needs longer bootup time.

config PMW3610_REPORT_INTERVAL_MIN
	int "PMW3610's default minimum report rate"
	default 0
	help
	  Default minimum report interval in milliseconds.
	  Slow down input reporting for hid queue over the air.
	  Turn value down to 8ms to get sharp response if use with USB only.

config PMW3610_SMART_ALGORITHM
  bool "Enable an algorithm of PMW3610 to enhance surface coverage"
  default y
  help
    Enable the integration of the smart algorithm as the datasheet implementation.
    The algorithm is used to extend the tracking acrocss a wider range of surfaces
    such as graniles and tiles.

config PMW3610_RUN_DOWNSHIFT_TIME_MS
    int "PMW3610's default RUN mode downshift time"
    default 128
    range 13 3264
    help
      Default RUN mode downshift down time in milliseconds.
      Time after which sensor goes from RUN to REST1 mode.

config PMW3610_REST1_DOWNSHIFT_TIME_MS
    int "PMW3610's default REST1 mode downshift time"
    default 5000
    help
      Default REST1 mode downshift down time in milliseconds.
      Time after which sensor goes from REST1 to REST2 mode.

config PMW3610_REST2_DOWNSHIFT_TIME_MS
    int "PMW3610's default REST2 mode downshift time"
    default 17000
    help
      Default REST2 mode downshift down time in milliseconds.
      Time after which sensor goes from REST2 to REST3 mode.

config PMW3610_REST1_SAMPLE_TIME_MS
    int "PMW3610's sample time in REST1 stage"
    default 40
    # range 10 2550
    help
      Default REST1 mode sample period in millisecond

config PMW3610_REST2_SAMPLE_TIME_MS
    int "PMW3610's sample time in REST2 stage"
    default 100
    # range 10 2550
    help
      Default REST2 mode sample period in millisecond.

config PMW3610_REST3_SAMPLE_TIME_MS
    int "PMW3610's sample time in REST3 stage"
    default 500
    # range 10 2550
    help
      Default REST2 mode sample period in millisecond.

module = PMW3610
module-str = PMW3610
source "${ZEPHYR_BASE}/subsys/logging/Kconfig.template.log_config"

endif #PMW3610

config ZMK_PMW3610_STUDIO_RPC
    bool "Enable PMW3610 custom Studio RPC"
    depends on ZMK_STUDIO
    select ZMK_PMW3610_PROTOBUF
    help
      Custom (unofficial) ZMK Studio RPC subsystem exposing PMW3610 sensor
      info and diagnostics. Works with zero PMW3610 devices present (e.g.
      native_sim), so it does not depend on CONFIG_PMW3610 directly.

# Not scoped `if ZMK_PMW3610_STUDIO_RPC`: the frame capture/streaming
# handlers that use this buffer (src/studio/pmw3610_request_exec.c) also
# compile under CONFIG_ZMK_PMW3610_SPLIT_RPC_RELAY alone (a split peripheral
# has no Studio of its own -- see DESIGN.md Phase F).
config ZMK_PMW3610_STUDIO_RPC_FRAME_BUF_SIZE
    int "Static frame capture buffer size (pixels/bytes)"
    default 484
    depends on ZMK_PMW3610_PROTOBUF
    help
      Size of the static frame buffer used by the CaptureFrame/GetFrameChunk
      handlers (one byte per pixel). The default (484 = 22x22) matches the
      driver's default capture pixel count. A CaptureFrame request's
      pixel_count is clamped to this size.

config ZMK_PMW3610_SPLIT_RPC_RELAY
    bool "Relay PMW3610 Studio RPC to split peripherals"
    depends on ZMK_SPLIT_RELAY_EVENT
    select ZMK_PMW3610_PROTOBUF
    help
      Enable on BOTH halves of a split keyboard to reach PMW3610 devices
      living on a split peripheral through the central's cormoran__pmw3610
      Studio RPC subsystem: any request (GetInfo/ReadDiagnostics/
      ReadRegister/WriteRegister/CaptureFrame/GetFrameChunk/SetFrameStream)
      with a nonzero `source` is relayed to the matching peripheral over
      CONFIG_ZMK_SPLIT_RELAY_EVENT, and the response arrives back as a
      PeripheralResponse Studio notification (relaying is asynchronous,
      unlike a local request). A peripheral's SetFrameStream chunks relay
      back the same way, as FrameStreamChunk notifications with `source`
      filled in. Increase CONFIG_ZMK_SPLIT_RELAY_EVENT_DATA_LEN if your
      build fails a BUILD_ASSERT about the relayed request/response payload
      size (a GetInfoResponse for multiple peripheral devices needs more
      room than the framework's default).
      Note: the underlying split relay event transport broadcasts to every
      connected peripheral, not to one addressed peripheral -- with more
      than one peripheral, every peripheral answers every relayed request
      (each correctly tagged with its own source), which does not compose
      well with a UI that only expects an answer from a specific one. Safe
      to enable for a build with a single peripheral.

config ZMK_PMW3610_SPLIT_RPC_RELAY_TEST
    bool "Enable native_sim-only PMW3610 split relay test hooks"
    depends on ZMK_PMW3610_SPLIT_RPC_RELAY
    help
      Adds a boot-time self-test that bypasses the real split transport
      (which native_sim cannot exercise end-to-end) and asserts firmware
      behavior directly, printing PASS/FAIL to the log:
        - Peripheral role: synthesizes a relayed request locally and
          asserts the resulting relay response -- see
          tests/split_peripheral.
        - Central role: asserts pmw3610_relay_broadcast_request() assigns
          distinct nonzero request_ids -- see tests/split_central.
      Not for production builds.

# Internal: whether nanopb should generate code for pmw3610*.proto. Split out
# from ZMK_PMW3610_STUDIO_RPC (which additionally implies CONFIG_ZMK_STUDIO,
# unavailable on a split peripheral) so a split peripheral -- which has no
# Studio of its own -- can still encode/decode these messages for relaying.
# `select NANOPB` (+ the same `imply`s ZMK_STUDIO_RPC itself uses) directly,
# rather than relying on CONFIG_ZMK_STUDIO_RPC to have pulled NANOPB in --
# on a split peripheral, ZMK_STUDIO_RPC is never selected (ZMK_STUDIO only
# `select`s it `if !ZMK_SPLIT || ZMK_SPLIT_ROLE_CENTRAL`), so without this
# the nanopb runtime headers (pb.h) are unavailable even though nanopb code
# generation itself (nanopb_generate_cpp in CMakeLists.txt) still runs.
config ZMK_PMW3610_PROTOBUF
    bool
    select NANOPB
    imply NANOPB_NO_ERRMSG
    imply NANOPB_WITHOUT_64BIT
    imply NANOPB_NO_ENCODE_SIZE_CHECK
    # Frame streaming's capture loop (src/studio/pmw3610_request_exec.c) and,
    # when ZMK_PMW3610_SPLIT_RPC_RELAY is also on, every split relay listener
    # (src/split/pmw3610_relay.c) defer their protobuf decode/exec/encode
    # work onto ZMK's dedicated low-priority workqueue instead of running
    # inline on whichever caller thread (system workqueue, in most cases)
    # dispatched them -- see the file-level comment in pmw3610_relay.c for
    # why (a real stack overflow on the system workqueue, confirmed on
    # hardware, from exactly this work running there).
    select ZMK_LOW_PRIORITY_WORK_QUEUE

config ZMK_PMW3610_CUSTOM_SETTINGS
    bool "Enable PMW3610 runtime settings via zmk-feature-custom-settings"
    depends on ZMK_CUSTOM_SETTINGS
    help
      Registers PMW3610 sensor parameters (cpi, downshift/sample times,
      axis flags, force-awake, smart algorithm, minimum report interval) as
      custom settings (subsystem "cormoran__pmw3610"), readable/writable
      over the generic custom-settings Studio RPC subsystem and persisted
      via the Zephyr settings subsystem. Works with zero PMW3610 devices
      present (e.g. native_sim), so it does not depend on CONFIG_PMW3610
      directly -- it just has nothing to apply the settings to.
```

## dts/bindings/cormoran,pmw3610.yml
```yaml
description: |
  Sensor driver for the pixart PMW3610 mouse sensor

compatible: "cormoran,pmw3610"

include: spi-device.yaml

properties:
  irq-gpios:
    type: phandle-array
    required: true
  cpi:
    type: int
    default: 600
    description: "CPI value (Range: 200 - 3200, Step: 200)"
  evt-type:
    type: int
    required: true
  x-input-code:
    type: int
    required: true
  y-input-code:
    type: int
    required: true
  force-awake:
    type: boolean
  disable-burst-read:
    type: boolean
  settings-id:
    type: string
    description: |
      Stable short id (recommended: up to 8 ASCII characters) used to build
      this device's per-device custom setting keys ("<param>@<id>") and
      reported in the GetInfo Studio RPC response, so a firmware image with
      multiple PMW3610 devices (or the same devicetree used across a split
      keyboard's halves) gets independently persisted settings and a stable
      web UI identity per sensor. Recommended when there is more than one
      PMW3610 device in one firmware image (e.g. "trackball", "thumb") --
      when omitted, a 4-hex-digit hash of this node's devicetree path is used
      instead, which is stable across reordering of sibling devicetree nodes
      but is not human-readable.
```

## tests/zmk-config/boards/shields/pmw3610_ble_split/Kconfig.defconfig
```kconfig
# Roles + a stable advertised name for the renode-ble-host to scan for.
# Mirrors zmk-west-commands' renode_split shield, but the central here also
# fronts the PMW3610 split RPC relay (enabled via the build-ble-split.yaml
# snippets), and the peripheral carries a real PMW3610 (its overlay).

if SHIELD_PMW3610_BLE_SPLIT_LEFT

# The central is the DUT the renode-ble-host connects to; its advertised name
# must start with CONFIG_RENODE_BLE_HOST_TARGET_NAME (built as "PMW3610").
config ZMK_KEYBOARD_NAME
    default "PMW3610 Central"

config ZMK_SPLIT_ROLE_CENTRAL
    default y

endif

if SHIELD_PMW3610_BLE_SPLIT_RIGHT

config ZMK_KEYBOARD_NAME
    default "PMW3610 Periph"

endif

if SHIELD_PMW3610_BLE_SPLIT_LEFT || SHIELD_PMW3610_BLE_SPLIT_RIGHT

config ZMK_SPLIT
    default y

endif
```

## tests/zmk-config/boards/shields/pmw3610_ble_split/Kconfig.shield
```kconfig
config SHIELD_PMW3610_BLE_SPLIT_LEFT
    def_bool $(shields_list_contains,pmw3610_ble_split_left)

config SHIELD_PMW3610_BLE_SPLIT_RIGHT
    def_bool $(shields_list_contains,pmw3610_ble_split_right)
```

## tests/zmk-config/boards/shields/pmw3610_usb_wired_split/Kconfig.defconfig
```kconfig
# Roles + names for the usb+wired PMW3610 split. The central (left) fronts the
# PMW3610 split RPC relay and answers Studio over USB; the peripheral (right)
# carries the real PMW3610 and the relay's peripheral role. Split transport is
# WIRED -- BLE is disabled in the .conf files (unlike pmw3610_ble_split).

if SHIELD_PMW3610_USB_WIRED_SPLIT_LEFT

config ZMK_KEYBOARD_NAME
    default "PMW3610 UWCentral"

config ZMK_SPLIT_ROLE_CENTRAL
    default y

endif

if SHIELD_PMW3610_USB_WIRED_SPLIT_RIGHT

config ZMK_KEYBOARD_NAME
    default "PMW3610 UWPeriph"

endif

if SHIELD_PMW3610_USB_WIRED_SPLIT_LEFT || SHIELD_PMW3610_USB_WIRED_SPLIT_RIGHT

config ZMK_SPLIT
    default y

endif
```

## tests/zmk-config/boards/shields/pmw3610_usb_wired_split/Kconfig.shield
```kconfig
config SHIELD_PMW3610_USB_WIRED_SPLIT_LEFT
    def_bool $(shields_list_contains,pmw3610_usb_wired_split_left)

config SHIELD_PMW3610_USB_WIRED_SPLIT_RIGHT
    def_bool $(shields_list_contains,pmw3610_usb_wired_split_right)
```
